## CMakeLists.txt
```
#
# Copyright (c) 2024 Nordic Semiconductor ASA
#
# SPDX-License-Identifier: LicenseRef-Nordic-5-Clause
#

cmake_minimum_required(VERSION 3.20.0)

find_package(Zephyr REQUIRED HINTS $ENV{ZEPHYR_BASE})
project(wifi_ble_radio_test)

# NORDIC SDK APP START
target_sources(app PRIVATE
  src/early_shell_start.c
)

target_sources_ifdef(CONFIG_SOC_SERIES_NRF71 app PRIVATE
  src/ficr_mac_print.c
)

target_sources_ifdef(CONFIG_RADIO_TEST_VTF_XO_FROM_XTALCOMP app PRIVATE
  src/xo_vtf.c
)

# Include BLE radio test sources only in default mode
if(NOT CONFIG_SAMPLE_WIFI_RADIO_TEST_WIFI_ONLY)
  set(perip_rt_dir ${ZEPHYR_NRF_MODULE_DIR}/samples/peripheral/radio_test)
  file(GLOB perip_rt_sources ${perip_rt_dir}/src/*.c)

  target_sources(app PRIVATE ${perip_rt_sources})
endif()
# NORDIC SDK APP END
```

## Kconfig
```
#
# Copyright (c) 2024 Nordic Semiconductor
#
# SPDX-License-Identifier: LicenseRef-Nordic-5-Clause
#

mainmenu "Nordic Wi-Fi Bluetooth LE Radio test sample"

config SAMPLE_WIFI_RADIO_TEST_WIFI_ONLY
	bool "Wi-Fi only mode"
	help
	  Enable Wi-Fi only radio test mode, excluding peripheral BLE radio test
	  sources. BLE stack support remains enabled on combo chips.

config RADIO_TEST_VTF_XO_FROM_XTALCOMP
	bool "Feed the VTF XO frequency offset from FICR/UICR XTALCOMP.OFFSET"
	depends on SOC_SERIES_NRF71 && VTF_MONITORING
	help
	  Register a VTF_CH_FREQ_OFFSET backend that reads FICR XTALCOMP.OFFSET,
	  falling back to UICR XTALCOMP.OFFSET, and writes it to the VTF snapshot
	  before the Wi-Fi core starts. A blank (0xFFFFFFFF) value means 0 ppm.

rsource "$(ZEPHYR_NRF_MODULE_DIR)/samples/peripheral/radio_test/Kconfig"
```

## prj.conf
```kconfig
#
# Copyright (c) 2022 Nordic Semiconductor ASA
#
# SPDX-License-Identifier: LicenseRef-Nordic-5-Clause
#
CONFIG_WIFI=y
CONFIG_WIFI_NRF70=y
CONFIG_NRF70_RADIO_TEST=y

#CONFIG_INIT_STACKS=y

# Memories
CONFIG_MAIN_STACK_SIZE=5200
CONFIG_SHELL_STACK_SIZE=5200
#64K memory needed for IQ sample captures.
CONFIG_HEAP_MEM_POOL_SIZE=65536
CONFIG_NRF_WIFI_CTRL_HEAP_SIZE=32768
CONFIG_HEAP_MEM_POOL_IGNORE_MIN=y


# Debugging
CONFIG_STACK_SENTINEL=y
CONFIG_DEBUG_COREDUMP=y
CONFIG_DEBUG_COREDUMP_BACKEND_LOGGING=y
CONFIG_DEBUG_COREDUMP_MEMORY_DUMP_MIN=y
CONFIG_SHELL_CMDS_RESIZE=n
#CONFIG_DEBUG=y

# Logging
CONFIG_LOG=y
CONFIG_PRINTK=y
CONFIG_SHELL=y
CONFIG_SHELL_GETOPT=y
CONFIG_DEVICE_SHELL=y
CONFIG_POSIX_TIMERS=y
CONFIG_DATE_SHELL=y
CONFIG_LOG_BUFFER_SIZE=4096
CONFIG_SHELL_BACKEND_SERIAL_RX_RING_BUFFER_SIZE=1024

# Peripheral radio test configuration
CONFIG_CONSOLE_HANDLER=y
CONFIG_SHELL=y

CONFIG_DYNAMIC_INTERRUPTS=y

CONFIG_NRFX_TIMER0=y
CONFIG_CLOCK_CONTROL=y

CONFIG_ENTROPY_GENERATOR=y
CONFIG_NRF_SECURITY=y

CONFIG_FEM_AL_LIB=y
CONFIG_PICOLIBC_IO_FLOAT=y

# PCB loss settings
CONFIG_NRF70_PCB_LOSS_2G=1
CONFIG_NRF70_PCB_LOSS_5G_BAND1=2
CONFIG_NRF70_PCB_LOSS_5G_BAND2=2
CONFIG_NRF70_PCB_LOSS_5G_BAND3=2

# Antenna gain settings
CONFIG_NRF70_ANT_GAIN_2G=1
CONFIG_NRF70_ANT_GAIN_5G_BAND1=4
CONFIG_NRF70_ANT_GAIN_5G_BAND2=4
CONFIG_NRF70_ANT_GAIN_5G_BAND3=4
```

## src/ficr_mac_print.c
```c
/*
 * Copyright (c) 2026 Nordic Semiconductor ASA
 *
 * SPDX-License-Identifier: LicenseRef-Nordic-5-Clause
 */

#include <nrfx.h>

#include <zephyr/init.h>
#include <zephyr/logging/log.h>

LOG_MODULE_REGISTER(ficr_mac_print, CONFIG_LOG_DEFAULT_LEVEL);

#define MACADDR_BLANK 0xFFFFFFFFu
#define MACADDR_SLOTS 2

static bool mac_slot_empty(uint32_t low, uint32_t high)
{
	return (low == MACADDR_BLANK) || (high == MACADDR_BLANK);
}

static void log_mac_slot(const char *block, unsigned int slot, uint32_t low, uint32_t high)
{
	if (mac_slot_empty(low, high)) {
		LOG_INF("%s MACADDR[%u]: not programmed", block, slot);
		return;
	}

	LOG_INF("%s MACADDR[%u]: %02X:%02X:%02X:%02X:%02X:%02X",
		block, slot,
		(uint8_t)(high >> 16), (uint8_t)(high >> 8), (uint8_t)high,
		(uint8_t)(low >> 16), (uint8_t)(low >> 8), (uint8_t)low);
}

static int ficr_mac_print_init(void)
{
	for (unsigned int slot = 0; slot < MACADDR_SLOTS; slot++) {
		log_mac_slot("FICR", slot,
			     NRF_FICR->MACADDR[slot].LOW,
			     NRF_FICR->MACADDR[slot].HIGH);
		log_mac_slot("UICR", slot,
			     NRF_UICR->MACADDR[slot].LOW,
			     NRF_UICR->MACADDR[slot].HIGH);
	}

	return 0;
}

BUILD_ASSERT(92 > CONFIG_SHELL_BACKEND_SERIAL_INIT_PRIORITY,
	     "ficr_mac_print must run after the shell UART backend init");
SYS_INIT(ficr_mac_print_init, POST_KERNEL, 92);
```

## src/xo_vtf.c
```c
/*
 * Copyright (c) 2026 Nordic Semiconductor ASA
 *
 * SPDX-License-Identifier: LicenseRef-Nordic-5-Clause
 */

#include <nrfx.h>

#include <zephyr/kernel.h>
#include <zephyr/logging/log.h>

#include <vtf_monitoring/vtf_monitoring.h>

LOG_MODULE_REGISTER(xo_vtf, CONFIG_VTF_LOG_LEVEL);

#define XTALCOMP_BLANK 0xFFFFFFFFu

static int32_t xtalcomp_offset_read(void)
{
	uint32_t raw = NRF_FICR->XTALCOMP.OFFSET;

	if (raw == XTALCOMP_BLANK) {
		raw = NRF_UICR->XTALCOMP.OFFSET;
	}

	return (raw == XTALCOMP_BLANK) ? 0 : (int32_t)raw;
}

static int xo_vtf_init(void)
{
	int32_t offset = xtalcomp_offset_read();

	vtf_snapshots[VTF_CH_FREQ_OFFSET].i32 = offset;
	LOG_INF("XO offset from XTALCOMP: %d ppm", offset);

	return 0;
}

static int xo_vtf_sample(struct vtf_sample *out)
{
	out->type = VTF_SAMPLE_TYPE_INT;
	out->value.i32 = xtalcomp_offset_read();
	out->timestamp_ms = k_uptime_get();
	out->status = VTF_STATUS_OK;

	return 0;
}

VTF_CHANNEL_DEFINE(xo_vtf_channel, VTF_CH_FREQ_OFFSET, xo_vtf_sample, xo_vtf_init,
		   VTF_SAMPLE_TYPE_INT, i32, CONFIG_VTF_FREQ_OFFSET_DEFAULT_VALUE);
```
